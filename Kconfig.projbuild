## Kconfig.projbuild
```kconfig
menu "RF 315/433 Module Receiver"

    menu "Protocols"
        config RF_MODULE_PROTOCOL_EV1527
            bool "EV1527 chip protocol (Protocol 1)"
            default y
            help
                Support devices based on EV1527, RT1527, FP1527, HS1527, etc chips.

        config RF_MODULE_PROTOCOL_2
            bool "RC Switch's Protocol 2"
            default n
            help
                Not tested yet

        config RF_MODULE_PROTOCOL_3
            bool "RC Switch's Protocol 3"
            default n
            help
                Not tested yet

        config RF_MODULE_PROTOCOL_4
            bool "RC Switch's Protocol 4"
            default n
            help
                Not tested yet

        config RF_MODULE_PROTOCOL_5
            bool "RC Switch's Protocol 5"
            default n
            help
                Not tested yet

        config RF_MODULE_PROTOCOL_HT6P20B
            bool "HT6P20B chip protocol (Protocol 6)"
            default n
            help
                Not tested yet

        config RF_MODULE_PROTOCOL_HS2303_PT
            bool "HS2303-PT chip protocol (Protocol 7)"
            default n
            help
                Not tested yet

        config RF_MODULE_PROTOCOL_1BYONE
            bool "1ByOne Doorbell protocol (Protocol 10)"
            default n
            help
                Not tested yet

        config RF_MODULE_PROTOCOL_HT12E
            bool "HT12E chip protocol (Protocol 11)"
            default n
            help
                Not tested yet

        config RF_MODULE_PROTOCOL_SM5212
            bool "SM5212 chip protocol (Protocol 12)"
            default n
            help
                Not tested yet
    endmenu

    choice RF_MODULE_TASK_CORE_ID
        bool "Protocol parsers task Core ID"
        default RF_MODULE_TASK_PINNED_TO_NONE
        depends on !(FREERTOS_UNICORE || IDF_TARGET_ESP8266)
        help
            Pinned RF protocol parsers task to core 0 or core 1.
        config RF_MODULE_TASK_PINNED_TO_NONE
            bool "None"
        config RF_MODULE_TASK_PINNED_TO_CORE_0
            bool "Core 0"
        config RF_MODULE_TASK_PINNED_TO_CORE_1
            bool "Core 1"
    endchoice

    config RF_MODULE_TASK_PINNED_TO_CORE
        int
        default 0 if RF_MODULE_TASK_PINNED_TO_CORE_0
        default 1 if RF_MODULE_TASK_PINNED_TO_CORE_1

endmenu
```
